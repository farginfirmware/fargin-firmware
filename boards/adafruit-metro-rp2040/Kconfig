## boards/adafruit-metro-rp2040/Kconfig
```kconfig
config BOARD
    default "rpi-pico" if BOARD_ADAFRUIT_METRO_RP2040

config BOARD_ADAFRUIT_METRO_RP2040
    bool
    default y
    select CPU_MODEL_RP2040
```

## boards/custom-nrf52840/Kconfig
```kconfig
config BOARD
    default "nrf52840-mdk" if BOARD_NRF52840_MDK

config BOARD_NRF52840_MDK
    bool
    default y
    select CPU_MODEL_NRF52840XXAA
    select BOARD_COMMON_NRF52
    select HAS_PERIPH_I2C
    select HAS_PERIPH_SPI
    select HAS_PERIPH_UART
    select HAS_VDD_LC_FILTER_REG1

source "$(RIOTBOARD)/common/nrf52/Kconfig"
```

## boards/trinket-m0/Kconfig
```kconfig
config BOARD
    default "trinket-m0" if BOARD_TRINKET_M0

config BOARD_TRINKET_M0
    bool
    default y
    select BOARD_TRINKET_M0_BASE

rsource "Kconfig.trinket-m0-base"
```

## boards/trinket-m0/Kconfig.trinket-m0-base
```kconfig
config BOARD_TRINKET_M0_BASE
    bool
    default y
    select CPU_MODEL_SAMD21G18A
```
